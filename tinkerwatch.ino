/*******************
 * This code requires the PCF8814 library found here:
 * https://github.com/cattzalin/Arduino-library-nokia-1100-lcd--PCF8814
 * 
 * This Arduino program is intended to be used as a smartwatch
 * using parts from a Nokia 1100 cell phone. It will only work in
 * conjunction with the Android app that you can find here:
 * 
 * For more details on how to create your own smartwatch,
 * you can visit this website:
 * http://tinkernut.com/4keCX
 */

 //IMPORT THE PCF8814 LIBRARY (USE LINK ABOVE)
#include <PCF8814.h>

//DECLARE VARIABLES FOR THE LCD
static const byte ledPin = 8;
static const byte LCD_WIDTH = 96;
static const byte LCD_HEIGHT = 65;
static PCF8814 lcd;

//DECLARE VARIABLES FOR OTHER COMPONENTS
const int pwm = 3 ;
int lcdCount = 20;
const int btnPin = 2;
int held =0;
int restart=0;
int buttonState;  

//CREATE AN IMAGE FOR INCOMING CALLS
//(USE LCD ASSISTANT TO CONVERT IMAGES TO CODE)
static const byte ph_15 [] = {
0x3C, 0xFE, 0xFF, 0xFF, 0x1E, 0x08, 0x00, 0x00, 0x00, 0x00, 0x00, 0x00, 0x00, 0x00, 0x00, 0x00,
0x00, 0x00, 0x03, 0x07, 0x0F, 0x1E, 0x3C, 0x38, 0x70, 0x70, 0xF0, 0xF8, 0xFC, 0xF8, 0x78, 0x30
};
static const byte PHONE_WIDTH = 16;
static const byte PHONE_HEIGHT = 16;

//CREATE AN IMAGE FOR INCOMING TEXTS
static const byte txt_ico [] = {
0xF0, 0xE4, 0xCC, 0xDC, 0xBC, 0x3C, 0x7C, 0xFC, 0xFC, 0x7C, 0x3C, 0xBC, 0xDC, 0xCC, 0xE4, 0xF0,
0x1F, 0x3F, 0x3F, 0x3F, 0x3F, 0x3F, 0x3E, 0x3E, 0x3E, 0x3E, 0x3F, 0x3F, 0x3F, 0x3F, 0x3F, 0x1F
};
static const byte TEXT_WIDTH = 16;
static const byte TEXT_HEIGHT = 16;

//CREATE A SPLASH SCREEN IMAGE
static const byte tinkerwatch [] = {
0x00, 0x00, 0x00, 0x00, 0x00, 0x00, 0x00, 0x00, 0x00, 0x00, 0x00, 0x00, 0x00, 0x00, 0x00, 0x00,
0x20, 0xE0, 0xF0, 0xF0, 0xF8, 0xF8, 0xF8, 0xFC, 0xE0, 0xC0, 0xC0, 0xC0, 0xC0, 0xC0, 0xC0, 0xE0,
0xE0, 0xFE, 0xFE, 0xFE, 0xFE, 0xFE, 0xFE, 0xFC, 0x8C, 0x80, 0x80, 0x00, 0x00, 0x00, 0x00, 0x00,
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0x00, 0x03, 0x01, 0x00, 0x00, 0x00, 0x00, 0x00, 0x00, 0x00, 0x00, 0x00, 0x00, 0x00, 0x00, 0x00
};
static const byte LOGO_WIDTH = 64;
static const byte LOGO_HEIGHT = 64;

void setup() {
  
  //START A SERIAL SESSION
  Serial.begin(9600);
  
  //INITIALIZE THE LCD
  lcd.begin(LCD_WIDTH, LCD_HEIGHT);
  lcd.clear();
  
  //INITIALIZE THE ARDUINO PINS FOR INPUT/OUTPUT
  pinMode(btnPin, INPUT);
  pinMode(ledPin, OUTPUT);
  pinMode(pwm, OUTPUT);
  
  //TURN ON THE LCD AND INSERT TEXT AND LOGO
  digitalWrite(ledPin, HIGH);
  lcd.setCursor(10,0);
  lcd.print("TINKERWATCH");
  lcd.setCursor(10,1);
  lcd.drawBitmap(tinkerwatch, LOGO_WIDTH, LOGO_HEIGHT);
  
  //DELAY FOR 5 SECONDS AND THEN CLEAR THE LCD AND TURN BACKLIGHT OFF
  delay(5000);
  lcd.clear();
  digitalWrite(ledPin, LOW);
}



void loop() {
  
  //CHECK THE SERIAL PORT FOR INCOMING MESSAGES
  //THE ARDUINO APP SENDS A TEXT STRING THROUGH BLUETOOTH EVERY SECOND
  //THE STRING SHOULD RESEMBLE THIS:  date | time | phone | text \n
  while(Serial.available() > 0){
    
    //READ THE STRING TO THE FIRST "|" DIVIDER AND STORE AS A VARIABLE
    String myDate = Serial.readStringUntil('|');
    Serial.read();
    //STORE THE NEXT SECTION OF STRING AS A VARIABLE
    String myTime = Serial.readStringUntil('|');
    Serial.read();
    //STORE THE THIRD SECTION OF STRING AS A VARIABLE
    String myPhone = Serial.readStringUntil('|');
    Serial.read();
    //STORE THE FINAL SECTION AS A VARIABLE
    String myText  = Serial.readStringUntil('\n');
    
    //CHECK TO SEE WHAT IS STORED IN THE TIME VARIABLE
    //AND DISPLAY IT TO THE SCREEN
    if(myTime.indexOf('time') >= 0){
      lcd.setCursor(0,3);
      lcd.print("Comm Error");
   }else{
      lcd.setCursor(0,3);
      lcd.print("  " + myTime);
    }

    //CHECK TO SEE WHAT IS STORED IN THE DATE VARIABLE
    //AND DISPLAY IT TO THE SCREEN
    if(myDate.indexOf('date') >= 0){
      lcd.setCursor(0,2);
      lcd.clearLine();
   }else{
      lcd.setCursor(0,2);
      lcd.print(myDate);
   }

    //CHECK THE PHONE VARIABLE TO SEE IF A CALL IS
    //BEING RECIEVED. IF SO, TURN ON THE BACKLIGHT
    //AND VIBRATE THE MOTOR
    if(myPhone.indexOf('phone') >= 0){
      lcd.setCursor(0,6);
      lcd.clearLine();
      lcd.setCursor(0,7);
      lcd.clearLine();
      digitalWrite(pwm, LOW);
     // digitalWrite(ledPin, LOW);
   }else{
    digitalWrite(ledPin, HIGH);
      lcd.setCursor(0,6);
      lcd.drawBitmap(ph_15, PHONE_WIDTH, PHONE_HEIGHT);
      lcd.setCursor(PHONE_WIDTH + 1,6);
      lcd.print(myPhone);
      //Turn LCD On
      lcdCount = 10;
      //Motor Vibration Pattern
      digitalWrite(pwm, HIGH);
      delay(500);
      digitalWrite(pwm, LOW);
      delay(500);
      
   }

   //CHECK THE PHONE VARIABLE TO SEE IF A CALL IS
   //BEING RECIEVED. IF SO, TURN ON THE BACKLIGHT
   //AND VIBRATE THE MOTOR
   if(myText.indexOf('text') >= 0){
      lcd.setCursor(0,6);
      lcd.clearLine();
      lcd.setCursor(0,7);
      lcd.clearLine();
      digitalWrite(pwm, LOW);
     // digitalWrite(ledPin, LOW);
   }else{
      digitalWrite(ledPin, HIGH);
      lcd.setCursor(0,6);
      lcd.drawBitmap(txt_ico, TEXT_WIDTH, TEXT_HEIGHT);
      lcd.setCursor(PHONE_WIDTH + 1,6);
      lcd.print("Text From:");
      lcd.setCursor(PHONE_WIDTH + 1,7);
      lcd.print(myText);
      //Turn LCD On
      lcdCount = 10;
      //Motor Vibration Pattern
      digitalWrite(pwm, HIGH);
      delay(250);
      digitalWrite(pwm, LOW);
      delay(250);
      digitalWrite(pwm, HIGH);
      delay(250);
      digitalWrite(pwm, LOW);
      delay(250);
   }
  }
  
    //DETECT WHEN THE BUTTON HAS BEEN PRESSED
    //AND TURN ON THE BACKLIGHT
    buttonState = digitalRead(btnPin);
    if (buttonState == LOW) {
       held++;
    } else {
       held=0;
    }
    if(held > 10 && held < 100 && restart == 0){
     restart++;
      held=0;
    }else if(held > 500 && restart > 0){
      restart=0;
     held=0;
     //softReset();
     lcdCount = 0;
   }
   
   //BACKLIGHT LOOP
   if(lcdCount < 15 ){
     digitalWrite(ledPin, HIGH);
     lcdCount += 1;
   }
   if(lcdCount >= 15){
     digitalWrite(ledPin, LOW);
     lcdCount = 20;
    }
    
}
